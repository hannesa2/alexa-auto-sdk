## extensions/extras/amazonlite/meta-aac-amazonlite/conf/layer.conf
```bitbake
# We have a conf and classes directory, add to BBPATH
BBPATH .= ":${LAYERDIR}"

# We have recipes-* directories, add to BBFILES
BBFILES += "${LAYERDIR}/recipes-*/*/*.bb \
	${LAYERDIR}/recipes-*/*/*.bbappend"

BBFILE_COLLECTIONS += "aac-amazonlite"
BBFILE_PATTERN_aac-amazonlite = "^${LAYERDIR}/"
BBFILE_PRIORITY_aac-amazonlite = "6"

AMAZONLITE ?= "ON"
AMAZONLITE_PACKAGES = "${LAYERDIR}/packages"

PACKAGECONFIG_pn-aac-sample-cpp += "amazonlite"
```

## extensions/extras/co-assistant/meta-aac-extra-coassistant/conf/layer.conf
```bitbake
# We have a conf and classes directory, add to BBPATH
BBPATH .= ":${LAYERDIR}"

# We have recipes-* directories, add to BBFILES
BBFILES += "${LAYERDIR}/recipes-*/*/*.bb \
	${LAYERDIR}/recipes-*/*/*.bbappend"

BBFILE_COLLECTIONS += "aac-extra-coassistant"
BBFILE_PATTERN_aac-extra-coassistant = "^${LAYERDIR}/"
BBFILE_PRIORITY_aac-extra-coassistant = "7"

PACKAGECONFIG_pn-aac-sample-cpp += "coassistant"
```

## extensions/extras/local-voice-control/meta-aac-local-voice-control/conf/layer.conf
```bitbake
# We have a conf and classes directory, add to BBPATH
BBPATH .= ":${LAYERDIR}"

# We have recipes-* directories, add to BBFILES
BBFILES += "${LAYERDIR}/recipes-*/*/*.bb \
	${LAYERDIR}/recipes-*/*/*.bbappend"

BBFILE_COLLECTIONS += "aac-local-voice-control"
BBFILE_PATTERN_aac-local-voice-control = "^${LAYERDIR}/"
BBFILE_PRIORITY_aac-local-voice-control = "7"

LOCALVOICECONTROL ?= "ON"
LOCALVOICECONTROL_PACKAGES = "${LAYERDIR}/packages"

PACKAGECONFIG_pn-aac-sample-cpp += "lvc"
```
